## config/west.yml
```yaml
# Copyright (c) 2025 The ZMK Contributors
# SPDX-License-Identifier: LicenseRef-Nordic-5-Clause

manifest:
  remotes:
    - name: zmkfirmware
      url-base: https://github.com/zmkfirmware
    - name: nrfconnect
      url-base: https://github.com/nrfconnect
  projects:
    - name: zmk
      remote: zmkfirmware
      revision: main
      import: app/west.yml
    - name: sdk-nrf
      remote: nrfconnect
      # align to commit:
      #   https://github.com/nrfconnect/sdk-zephyr/blob/ffdab1b6b90658e0a9fc9a3ae64e45e37c3e9386/VERSION
      #   https://github.com/nrfconnect/sdk-nrf/commit/e50881920d7be8132024e1732dee3960fcac9829
      #   sdk-nrf v3.1.1 + sdk-zephyr v4.1.99
      revision: v3.1.0
      path: nrf
    - name: nrfxlib
      remote: nrfconnect
      revision: v3.1.0
      repo-path: sdk-nrfxlib
      path: nrfxlib
  self:
    path: config
```

## src/split/Kconfig
```kconfig
# Copyright (c) 2025 The ZMK Contributors
# SPDX-License-Identifier: LicenseRef-Nordic-5-Clause

if ZMK_SPLIT

config ZMK_SPLIT_ESB
    bool "Enable ZMK Split ESB"
    select ESB
    select ESB_DYNAMIC_INTERRUPTS
    select DYNAMIC_INTERRUPTS
    select DYNAMIC_DIRECT_INTERRUPTS
    select RING_BUFFER
    help
        Enables Enhanced ShockBurst protocol for ZMK split keyboards.
        If you enable this, you *must* also ensure that
        CONFIG_SYSTEM_WORKQUEUE_STACK_SIZE >= 2048
        CONFIG_MPSL_TIMESLOT_SESSION_COUNT >= 2
        CONFIG_ESB_MAX_PAYLOAD_LENGTH >= 48
        CONFIG_INPUT_THREAD_STACK_SIZE >= 2048
        CONFIG_INPUT_QUEUE_MAX_MSGS ~= 128
        in your prj.conf.


endif # ZMK_SPLIT

rsource "esb/Kconfig"
```

## src/split/esb/Kconfig
```kconfig
# Copyright (c) 2025 The ZMK Contributors
# SPDX-License-Identifier: MIT

if ZMK_SPLIT && ZMK_SPLIT_ESB

menu "ESB Transport"

config ZMK_SPLIT_ESB_ROLE_CENTRAL
    bool

endmenu

config ZMK_SPLIT_ESB_PRIORITY
    int "ESB transport priority"
    default 2
    help
        Lower number priorities transports are favored over higher numbers.

config ZMK_SPLIT_ESB_PERIPHERAL_ID
    int "Default peripheral id for TX"
    default 0

config ZMK_SPLIT_ESB_PERIPHERAL_COUNT
    int "Override peripheral count for RX in central.h (zero to disable overriding)"
    default 0

config ZMK_SPLIT_ESB_PROTO_TX_ACK
    bool "Await ACK signal per sending packet for TX/RX"
    default y

config ZMK_SPLIT_ESB_PROTO_TX_RETRANSMIT_DELAY
    int "The delay between each retransmission of unacknowledged packets"
    default 600

config ZMK_SPLIT_ESB_PROTO_TX_RETRANSMIT_COUNT
    int "The number of retransmission attempts before transmission fail"
    default 3

config ZMK_SPLIT_ESB_PROTO_MSGQ_ITEMS
    int "Number of message queue size to buffer ESB payload for TX in between multi-protocol service timeslots (CONFIG_MPSL_TIMESLOT_SESSION_COUNT)"
    default 64

config ZMK_SPLIT_ESB_EVENT_BUFFER_ITEMS
    int "Number of peripheral events to buffer for TX/RX"
    default 64

config ZMK_SPLIT_ESB_CMD_BUFFER_ITEMS
    int "Number of central commands to buffer for TX/RX"
    default 16

config ZMK_SPLIT_ESB_RETRY_INPUT_EVENT
    int "Retry count for input events"
    default 0

config ZMK_SPLIT_ESB_RETRY_KEY_POSITION
    int "Retry count for key position events"
    default 3

config ZMK_SPLIT_ESB_RETRY_SENSOR_EVENT
    int "Retry count for sensor events"
    default 2

config ZMK_SPLIT_ESB_RETRY_BATTERY_EVENT
    int "Retry count for battery events"
    default 1

config ZMK_SPLIT_ESB_RETRY_CMD
    int "Retry count for central commands"
    default 1

config ZMK_SPLIT_ESB_MSGQ_FULL_TIMEOUT_MS
    int "Timeout (ms) to clear retry table when msgq stays full"
    default 3000

module = ZMK_SPLIT_ESB
module-str = ZMK_SPLIT_ESB
source "${ZEPHYR_BASE}/subsys/logging/Kconfig.template.log_config"

endif #ZMK_SPLIT && ZMK_SPLIT_ESB

# **************************************************************************
# Following config is cloned for battery monitoring, if BLE is not enabled.
# **************************************************************************

if ZMK_SPLIT && !ZMK_SPLIT_BLE
if ZMK_SPLIT_ROLE_CENTRAL

config ZMK_SPLIT_BLE_CENTRAL_PERIPHERALS
    int "Number of peripherals that will connect to the central."

config ZMK_SPLIT_BLE_CENTRAL_BATTERY_LEVEL_FETCHING
    bool "Fetch Peripheral Battery Level Info"

if ZMK_SPLIT_BLE_CENTRAL_BATTERY_LEVEL_FETCHING

config ZMK_SPLIT_BLE_CENTRAL_BATTERY_LEVEL_QUEUE_SIZE
    int "Max number of battery level events to queue when received from peripherals"
    default ZMK_SPLIT_BLE_CENTRAL_PERIPHERALS

config ZMK_SPLIT_BLE_CENTRAL_BATTERY_LEVEL_PROXY
    bool "Proxy Peripheral Battery Level Info"

endif #ZMK_SPLIT_BLE_CENTRAL_BATTERY_LEVEL_FETCHING

endif #ZMK_SPLIT_ROLE_CENTRAL
endif #ZMK_SPLIT && !ZMK_SPLIT_BLE
```
